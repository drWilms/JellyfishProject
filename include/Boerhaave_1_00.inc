/*
Boerhaave 1.00 pins
*/

// ========   Digital I/O used   =========


#define SDA           21
#define SCL           22
#define SD_CS          5
#define SPI_MOSI      23
#define SPI_MISO      19
#define SPI_SCK       18

#define I2S_DOUT      14
#define I2S_BCLK      13
#define I2S_LRC       15

#define LED           2

#define PixelLedDataOut 4



#define LED_PIN PixelLedDataOut        // LED-strip data pin
//#define NUM_LEDS 88     // Aantal LEDs






/*
#define MP3_RXD1 16 
#define MP3_TXD1 17

#define RS485_RXD1 25 
#define RS485_TXD1 26
#define RS485_Cntr    27

#define IDSw_1        34
#define IDSw_2        35
#define IDSw_3        32
#define IDSw_4        33
*/
