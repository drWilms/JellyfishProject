// test
#include <FastLED.h>

#define LED_TYPE WS2811
#define COLOR_ORDER GRB
//#define NUM_LEDS 21

CRGBArray<NUM_LEDS> leds;
void SetLED(int i, CRGB color);
void SetRLEDs(u_int8_t r, CRGB color);
/*

uint8_t nLed[NUM_LEDS] ={120,119,118,117,116,115,114,113,112,111,110,109,108,107,106,105,104,103,102,101,100,99,98,97,96,95,94,93,92,91,90,89,88,87,86,85,84,83,82,81,80,79,78,77,76,75,74,73,72,71,70,69,68,67,66,65,64,63,62,61,60,
    59,58,57,56,55,54,53,52,51,50,49,48,47,46,45,44,43,42,41,40,39,38,37,36,35,34,33,32,31,30,29,28,27,26,25,24,23,22,21,20,19,18,17,16,15,14,13,12,11,10,9,8,7,6,5,4,3,2,1,0};
*/

//uint8_t nLed[NUM_LEDS] = {0, 1, 2, 3, 4, 5, 10, 15, 20, 25, 24, 23, 22, 21, 16, 11, 6, 7, 8, 9, 14, 19, 18, 17, 12, 13};
// uint8_t nLed[NUM_LEDS] = {0, 1, 6, 11, 16, 21, 22, 23, 24, 25, 20, 15, 10, 5, 4, 3, 2, 7, 12, 17, 18, 19, 14, 9, 8, 13};
//uint8_t nLed[NUM_LEDS] = {0, 1, 2, 3, 4, 5, 6, 7, 8, 9, 10, 11, 12, 13, 14, 15, 16, 17, 18, 19, 20, 21, 22, 23, 24, 25};

// static uint8_t rLed[NUM_LEDS] = {0, 1, 6, 11, 16, 21, 22, 23, 24, 25, 20, 15, 10, 5, 4, 3, 2, 7, 12, 17, 18, 19, 14, 9, 8, 13};
#define nRings 4
#define nLedsRing1 45  //120-76
static uint8_t rLed1[nLedsRing1] = {120,119,118,117,116,115,114,113,112,111,110,109,108,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77,76};
#define nLedsRing2 35 // 70-41  =
static uint8_t rLed2[nLedsRing2] = {75,74,73,72,71,70,69,68,67,66,65,64,63,62,61,60,59,58,57,56,55,54,53,52,51,50,49,48,47,46,45,44,43,42,41};
#define nLedsRing3 24 // 40-17 == 81-104
static uint8_t rLed3[nLedsRing3] = {40,39,38,37,36,35,34,33,32,31,30,29,28,27,26,25,24,23,22,21,20,19,18,17};
#define nLedsRing4 16 // 16-1  105=120
static uint8_t rLed4[nLedsRing4] = {16,15,14,13,12,11,10,9,8,7,6,5,4,3,2,1};
